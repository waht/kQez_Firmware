## config/boards/shields/kqez/Kconfig.defconfig
```kconfig
# Copyright (c) 2020 The ZMK Contributors
# SPDX-License-Identifier: MIT

if SHIELD_KQEZ

config ZMK_KEYBOARD_NAME
    default "kQEZ"

endif
```
